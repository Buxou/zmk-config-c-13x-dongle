## boards/shields/c-13x/Kconfig.shield
```kconfig
config SHIELD_C-13X_CENTRAL
    def_bool $(shields_list_contains, c-13x_central)

config SHIELD_C-13X_DONGLE
    def_bool $(shields_list_contains,c-13x_dongle)

config SHIELD_C-13X_PERIPHERAL
    def_bool $(shields_list_contains, c-13x_peripheral)
```
